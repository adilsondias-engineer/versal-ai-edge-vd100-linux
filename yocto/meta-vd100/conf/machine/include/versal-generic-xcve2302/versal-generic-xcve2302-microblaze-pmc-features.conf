## yocto/meta-vd100/conf/machine/include/versal-generic-xcve2302/versal-generic-xcve2302-microblaze-pmc-features.conf
```bitbake
MACHINE_FEATURES = "cframe cfupmc common csudma emacps gpiops iomodule qspipsu ipipsu sdps sysmonpsv trngpsv ttcps uartlite uartpsv usbpsu zdma"
```

## yocto/meta-vd100/conf/machine/include/versal-generic-xcve2302/versal-generic-xcve2302-microblaze-psm-features.conf
```bitbake
MACHINE_FEATURES = "cframe cfupmc common csudma emacps gpiops iomodule qspipsu ipipsu rtcpsu sdps sysmonpsv tmr-inject tmr-manager trngpsv ttcps uartlite uartpsv usbpsu zdma"
```
